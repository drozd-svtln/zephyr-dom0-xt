## boards/rpi_5.conf
```kconfig
# Copyright (c) 2024 EPAM Systems
# SPDX-License-Identifier: Apache-2.0

CONFIG_XEN_DOM0=y

CONFIG_XSTAT=y
CONFIG_XSTAT_SHELL_CMDS=y

CONFIG_SHELL_STACK_SIZE=4096

CONFIG_MAIN_STACK_SIZE=8192
CONFIG_ISR_STACK_SIZE=8192

CONFIG_XEN_VCH=y
CONFIG_XEN_DOM0LESS_BOOT=y

CONFIG_USE_DEFAULT_DOM_CFG=n
CONFIG_DOM_CFG_BUILTIN_IMAGES=n

CONFIG_DOM_STORAGE_FATFS_ENABLE=y

CONFIG_FILE_SYSTEM_SHELL=y

CONFIG_NOCACHE_MEMORY=y
CONFIG_FS_FATFS_MULTI_PARTITION=y
CONFIG_FS_FATFS_CUSTOM_MOUNT_POINT_COUNT=8
CONFIG_DOM_STORAGE_FATFS_LOGICAL_DRIVE_NAME="1"
CONFIG_DOM_STORAGE_FATFS_DIR="dom0/"
CONFIG_XEN_LIBFDT=y

CONFIG_DOM_CFG_LINUX_PV_DOMAIN=y

CONFIG_XRUN_STORAGE_DMA_DEBOUNCE=4

CONFIG_DOMU_MAX=5

CONFIG_XEN_DOMCTL_INTERFACE_VERSION=0x16
CONFIG_XEN_DOMCTL_XENTROOPS_ARCH_VGSX_OSID=y
CONFIG_XEN_DOMCTL_XENTROOPS_ARCH_SCI_TYPE=y

CONFIG_PCIE=n
CONFIG_PCIE_CONTROLLER=n

#
CONFIG_REGULATOR=n
CONFIG_SPI=y
# CONFIG_SDMMC_VOLUME_NAME="SD"
CONFIG_CLOCK_CONTROL=y
CONFIG_TIMESLICE_SIZE=0
CONFIG_MAIN_STACK_SIZE=4096
CONFIG_SYSTEM_WORKQUEUE_STACK_SIZE=2048
CONFIG_ISR_STACK_SIZE=4096
CONFIG_TICKLESS_KERNEL=n

CONFIG_LOG_DEFAULT_LEVEL=4
CONFIG_LOG_MAX_LEVEL=4
```

## west.yml
```yaml
# SPDX-License-Identifier: Apache-2.0
# West YAML manifest for Zephyr as Xen Dom0

manifest:
  self:
    path: zephyr-dom0-xt

  remotes:
    - name: xentroops
      url-base: https://github.com/xen-troops/
    - name: zephyrproject-rtos
      url-base: https://github.com/zephyrproject-rtos/
    - name: darkon
      url-base: https://github.com/drozd-svtln/zephyr-xenlib.git

  projects:
    - name: zephyr
      remote: xentroops
      revision: 593e3f6c962e97d070efb0f99633dd92da3aa594
      west-commands: scripts/west-commands.yml
    - name: zephyr-xenlib
      remote: darkon
      revision: 7e8f69193bbeb93feed7227fd062d9fc5f50cdf0
    - name: fatfs
      remote: zephyrproject-rtos
      revision: f4ead3bf4a6dab3a07d7b5f5315795c073db568d
    - name: zephyr-xrun
      remote: xentroops
      revision: 5b6ecf274bac79b0be740693766a88d3eedf3b44
```
